## CMakeLists.txt
```
cmake_minimum_required(VERSION 3.20.0)
find_package(Zephyr REQUIRED HINTS $ENV{ZEPHYR_BASE})

project(powerOff3)

target_sources(app PRIVATE src/main.c)
target_sources_ifdef(CONFIG_APP_RETENTION app PRIVATE src/retained.c)
```

## Kconfig
```
mainmenu "Nordic SYSTEM_OFF demo"

config APP_RETENTION
	bool "State retention in system off"
	depends on SOC_COMPATIBLE_NRF52X && CRC
	help
	  On some Nordic chips this application supports retaining
	  memory while in system off.  Select this to enable the
	  feature.

source "Kconfig.zephyr"
```

## prj.conf
```kconfig
CONFIG_PM_DEVICE=y
CONFIG_CRC=y
CONFIG_POWEROFF=y
CONFIG_APP_RETENTION=y
```

## xiao_ble.overlay
```dts
/ {
    buttons {
        compatible = "gpio-keys";
        button0: button_0 {
            gpios = <&gpio0 2 (GPIO_PULL_UP | GPIO_ACTIVE_LOW)>;
            label = "Push button switch 0";
            zephyr,code = <2>;
        };

    };
    aliases{
        button=&button0;
    };

};
```

## src/main.c
```c
/*
 * Copyright (c) 2019 Nordic Semiconductor ASA
 *
 * SPDX-License-Identifier: Apache-2.0
 */

#include "retained.h"

#include <inttypes.h>
#include <stdio.h>

#include <zephyr/devicetree.h>
#include <zephyr/device.h>
#include <zephyr/drivers/gpio.h>
#include <zephyr/kernel.h>
#include <zephyr/pm/device.h>
#include <zephyr/sys/poweroff.h>
#include <zephyr/sys/util.h>

#define btn DT_ALIAS(button)
static const struct gpio_dt_spec sw0 = GPIO_DT_SPEC_GET(btn, gpios);

int main(void)
{
        int rc;
        const struct device *const cons = DEVICE_DT_GET(DT_CHOSEN(zephyr_console));

        if (!device_is_ready(cons))
        {
                printf("%s: device not ready.\n", cons->name);
                return 0;
        }
        printf("\n%s system off demo\n", CONFIG_BOARD);
        if (IS_ENABLED(CONFIG_APP_RETENTION))
        {
                bool retained_ok = retained_validate();
                /* Increment for this boot attempt and update. */
                retained.boots += 1;
                retained_update();
                printf("Retained data: %s\n", retained_ok ? "valid" : "INVALID");
                printf("Boot count: %u\n", retained.boots);
                printf("Off count: %u\n", retained.off_count);
                printf("Active Ticks: %" PRIu64 "\n", retained.uptime_sum);
        }
        else
        {
                printf("Retained data not supported\n");
        }

        /* configure sw0 as input, interrupt as level active to allow wake-up */
        rc = gpio_pin_configure_dt(&sw0, GPIO_INPUT);
        if (rc < 0)
        {
                printf("Could not configure sw0 GPIO (%d)\n", rc);
                return 0;
        }

        rc = gpio_pin_interrupt_configure_dt(&sw0, GPIO_INT_LEVEL_ACTIVE);
        if (rc < 0)
        {
                printf("Could not configure sw0 GPIO interrupt (%d)\n", rc);
                return 0;
        }

        printf("Entering system off; press sw0 to restart\n");

        rc = pm_device_action_run(cons, PM_DEVICE_ACTION_SUSPEND);
        if (rc < 0)
        {
                printf("Could not suspend console (%d)\n", rc);
                return 0;
        }

        if (IS_ENABLED(CONFIG_APP_RETENTION))
        {
                /* Update the retained state */
                retained.off_count += 1;
                retained_update();
        }

        sys_poweroff();

        return 0;
}
```

## src/retained.h
```c
/*
 * Copyright (c) 2021 Nordic Semiconductor ASA
 *
 * SPDX-License-Identifier: Apache-2.0
 */

#ifndef RETAINED_H_
#define RETAINED_H_

#include <stdbool.h>
#include <stdint.h>

/* Example of validatable retained data. */
struct retained_data
{
    /* The uptime from the current session the last time the
     * retained data was updated.
     */
    uint64_t uptime_latest;

    /* Cumulative uptime from all previous sessions up through
     * uptime_latest of this session.
     */
    uint64_t uptime_sum;

    /* Number of times the application has started. */
    uint32_t boots;

    /* Number of times the application has gone into system off. */
    uint32_t off_count;

    /* CRC used to validate the retained data.  This must be
     * stored little-endian, and covers everything up to but not
     * including this field.
     */
    uint32_t crc;
};

/* For simplicity in the sample just allow anybody to see and
 * manipulate the retained state.
 */
extern struct retained_data retained;

/* Check whether the retained data is valid, and if not reset it.
 *
 * @return true if and only if the data was valid and reflects state
 * from previous sessions.
 */
bool retained_validate(void);

/* Update any generic retained state and recalculate its checksum so
 * subsequent boots can verify the retained state.
 */
void retained_update(void);

#endif /* RETAINED_H_ */
```
