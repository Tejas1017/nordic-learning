## CMakeLists.txt
```
cmake_minimum_required(VERSION 3.20.0)
find_package(Zephyr REQUIRED HINTS $ENV{ZEPHYR_BASE})

project(isrUart)

target_sources(app PRIVATE src/main.c)
```

## prj.conf
```kconfig
CONFIG_LOG=y
CONFIG_LOG_MODE_MINIMAL=y
CONFIG_UART_ASYNC_API=y
CONFIG_UART_0_ASYNC=n
CONFIG_UART_0_INTERRUPT_DRIVEN=y
```

## src/main.c
```c
#include <zephyr/kernel.h>
#include <zephyr/device.h>
#include <zephyr/devicetree.h>
#include <zephyr/drivers/gpio.h>
#include <zephyr/drivers/uart.h>
#include <zephyr/logging/log.h>

#define SLEEP_TIME_OUT 1000
#define RECEIVE_BUFF_SIZE 10
#define RECEIVE_TIMEOUT 100

LOG_MODULE_REGISTER(isrUart, LOG_LEVEL_DBG);

const struct device *uart = DEVICE_DT_GET(DT_NODELABEL(uart0));
static const struct gpio_dt_spec led0 = GPIO_DT_SPEC_GET(DT_ALIAS(led0), gpios);

        static uint8_t toggle = 0;
static void uart_cb(const struct device *dev, void *user_data)
{
        // uint8_t data;
        // if (uart_irq_update(dev) && uart_irq_rx_ready(dev))
        // {
        //         if (uart_fifo_read(dev, &data, sizeof(data)))
        //         {
        //                 gpio_pin_toggle_dt(&led0);
        //         }
        //         if (toggle == 1)
        //         {
        //                 LOG_INF("Led is on");
        //                 toggle = 0;
        //         }
        //         else if (toggle == 0)
        //         {
        //                 LOG_INF("Led is off");
        //                 toggle = 1;
        //         }
        // }
         uint8_t data;
        if (uart_irq_update(dev) && uart_irq_rx_ready(dev))
        {
                if (uart_fifo_read(dev, &data, sizeof(data)))
                {
                        printk("Received data: %c\n", data);
                        gpio_pin_toggle_dt(&led0);
                }

        }
        if(toggle==1){
                printk("led is on\n");
                toggle=0;
        }
        else if(toggle==0){
                printk("led is off\n");
                toggle =1;
        }
}

int main(void)
{

        int ret;

        if (!device_is_ready(uart))
        {
                LOG_ERR("UART DEVICE NOT READY\r\n");
                return 1;
        }

        if (!device_is_ready(led0.port))
        {
                LOG_ERR("GPIO device is not ready\r\n");
                return 1;
        }

        ret = gpio_pin_configure_dt(&led0, GPIO_OUTPUT_ACTIVE);
        if (ret < 0)
        {
                return 1;
        }
        ret = uart_irq_callback_user_data_set(uart, uart_cb, NULL);
        if (ret)
        {
                return 1;
        }
        uart_irq_rx_enable(uart);

        while (1)
        {
                k_msleep(SLEEP_TIME_OUT);
        }
        return 0;
}
```
